## CMakeLists.txt
```
cmake_minimum_required(VERSION 3.20.0)
project(zephyr_test2)
find_package(Zephyr REQUIRED HINTS $ENV{ZEPHYR_BASE})
target_sources(app PRIVATE src/main.c)
```

## prj.conf
```kconfig
CONFIG_PRINTK=y
CONFIG_ASSERT=y
```

## src/main.c
```c
#include <zephyr/kernel.h>
#include <zephyr/sys/printk.h>

int main(void) {
	unsigned count = 0;

	while (1) {
		printk("count: %d, uptime: %lld ms\n", count++, 
				(unsigned long long)k_uptime_get());
		k_sleep(K_SECONDS(1));
	}

	return 0;
}
```
