## linux-bp.its
```
/dts-v1/;
/ {
    description = "FDT blobs";
    images {
        kernel-1 {
            description = "Linux kernel";
            data = /incbin/("$$(KERNEL_DATA_FILE)");
            type = "kernel";
            arch = "arm64";
            os = "linux";
            compression = "$$(KERNEL_DATA_COMPRESSION)";
            load = <$$(KERNEL_LOAD_ADDR)>;
            entry = <$$(KERNEL_ENTRY_ADDR)>;
        };
        fdt-1 {
            description = "Linux device tree";
            data = /incbin/("$$(FDT_DATA_FILE)");
            type = "flat_dt";
            arch = "arm64";
            compression = "none";
            load = <$$(FDT_LOAD_ADDR)>;
            fdt-version = <1>;
        };
        fdt-2 {
            description = "Linux device tree";
            data = /incbin/("$$(FDT2_DATA_FILE)");
            type = "flat_dt";
            arch = "arm64";
        };
    };
    configurations {
        default = "conf-1";
        conf-1 {
            description = "Set 1";
            kernel = "kernel-1";
            fdt = "fdt-1";
        };
        conf-2 {
            description = "Set 2";
            kernel = "kernel-1";
            fdt = "fdt-1", "fdt-2";
        };
        fdt-2 {
            description = "fdt-2";
            fdt = "fdt-2";
        };
    };
};
```

## meta-algae/conf/layer.conf
```bitbake
BBPATH .= ":${LAYERDIR}"

BBFILES += "${LAYERDIR}/recipes-*/*/*.bb \
            ${LAYERDIR}/recipes-*/*/*.bbappend"

BBFILE_COLLECTIONS += "algae"
BBFILE_PATTERN_algae = "^${LAYERDIR}/"
BBFILE_PRIORITY_algae = "8"

LAYERDEPENDS_algae = "core"
LAYERSERIES_COMPAT_algae = "scarthgap"
```

## uboot_fit-bp.its
```
/dts-v1/;
/ {
    description = "FDT blobs";
    images {
        kernel-1 {
            description = "Linux kernel";
            data = /incbin/("$$(KERNEL_DATA_FILE)");
            type = "kernel";
            arch = "arm64";
            os = "linux";
            compression = "$$(KERNEL_DATA_COMPRESSION)";
            load = <$$(KERNEL_LOAD_ADDR)>;
            entry = <$$(KERNEL_ENTRY_ADDR)>;
        };
        fdt-1 {
            description = "Linux device tree";
            data = /incbin/("$$(FDT_DATA_FILE)");
            type = "flat_dt";
            arch = "arm64";
            compression = "none";
            load = <$$(FDT_LOAD_ADDR)>;
            fdt-version = <1>;
        };
        dtbo-imx219 {
            description = "imx219 dtbo";
            data = /incbin/("$$(FDT_IMX219_DATA_FILE)");
            type = "flat_dt";
            arch = "arm64";
        };
    };
    configurations {
        default = "conf-1";
        conf-1 {
            description = "Set 1";
            kernel = "kernel-1";
            fdt = "fdt-1";
        };
        conf-imx219 {
            description = "Set 1, imx219";
            kernel = "kernel-1";
            fdt = "fdt-1", "dtbo-imx219";
        };
    };
};
```
